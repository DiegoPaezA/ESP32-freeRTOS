## wifi_connect_4/main/Kconfig.projbuild
```kconfig
  
menu "WIFI CONNECT"

config WIFI_SSID
    string "SSID"
    default "FAMILIA_PYP"

config WIFI_PASSWORD
    string "PASSWORD"
    default "SgYwZW1M"  

endmenu
```
